## src/drivers/esp32/Kconfig
```kconfig
menu "esp32"
    menuconfig COMMON_ESP32
        bool "Common esp32"
        default n
        select DRIVERS_ESP32_I2C32

        ---help---
            Enable default set of esp32 drivers
    rsource "*/Kconfig"
endmenu #esp32
```

## src/drivers/esp32/i2c32/Kconfig
```kconfig
menuconfig DRIVERS_ESP32_I2C32
	bool "i2c32"
	default n
	---help---
		Enable support for i2c32
```

## src/drivers/m113/Kconfig
```kconfig
menuconfig DRIVERS_M113
	bool "M113 direct CANopen actuator controller"
	default n
	depends on PLATFORM_NUTTX && !DRIVERS_UAVCAN
	---help---
		Control the M113 Thomson and MD80 actuators directly over classic CAN.
		This replaces the external ESP32 I2C-to-CAN bridge.
```
